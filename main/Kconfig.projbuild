## main/Kconfig.projbuild
```kconfig
# Kconfig options for mibee_homecam project

menu "mibee-cam Security Defaults"

    config MIBEE_CAM_DEFAULT_WEB_PASSWORD
        string "Default web management password"
        default "mibeecam2026"
        help
            First-boot / empty-migration default for the web management
            password (contract v1.1). mibeecam2026 is the documented public
            default (safe for README/docs); local builds may override it
            via the git-ignored sdkconfig.

endmenu

menu "mibee-cam CSI Motion Sensing (ESPectre)"

    config MIBEE_CSI_MOTION
        bool "Enable ESPectre WiFi CSI motion sensing"
        default n
        select ESP_WIFI_CSI_ENABLED if SOC_WIFI_CSI_SUPPORT
        help
            Embed the ESPectre sensing runtime (components/espectre, GPLv3)
            and start it after WiFi init. Logs motion-state changes only —
            no API/contract surface yet (pilot, 2026-09-06). Detection
            profile / CSI cadence are tuned under "ESPectre Sensing".
            Enabling this also compiles CSI support into esp_wifi
            (ESP_WIFI_CSI_ENABLED, ~a few KB RAM while sensing runs);
            with this option off the firmware is byte-identical to the
            pre-ESPectre baseline (verified 2026-09-06).

endmenu

menu "mibee-cam Recording Watermark"

    config MIBEE_WATERMARK
        bool "Enable photo/video watermark pipeline"
        default y
        help
            Compile the JPEG decode->render->re-encode watermark pipeline
            (issue #11; esp_jpeg decoder + vendored jpge encoder + font8x8).
            Runtime default is OFF via config keys (wm_enable=0) - with the
            keys off, the firmware behaves identically to the pre-watermark
            baseline. Set =n and rebuild to strip the code entirely
            (rollback path).

endmenu
```
